# NANO112AN_v1 register map
File version: 1.0
Registers are 32-bit, read-write, reset 0x0 unless marked. A register's access mark holds for its fields unless they carry their own. Offsets are from the block's base; [hi:lo] are bit positions; {n}, {i} and the like mark numbered series; 'fields as' and 'values as' point back to an identical list.

## INT — SCS Register Map
Base 0x50000300
0x00 IRQ0_SRC ro reset not defined — MCU IRQ0 (BOD_INT) Interrupt Source Identify
  [3:0] INT_SRC — Interrupt Source. Define the interrupt sources for interrupt event.
0x04 IRQ1_SRC ro reset not defined — MCU IRQ1 (WDT_INT) Interrupt Source Identify
  fields as IRQ0_SRC
0x08 IRQ2_SRC ro reset not defined — MCU IRQ2 (EINT0) Interrupt Source Identify
  fields as IRQ0_SRC
0x0C IRQ3_SRC ro reset not defined — MCU IRQ3 (EINT1) Interrupt Source Identify
  fields as IRQ0_SRC
0x10 IRQ4_SRC ro reset not defined — MCU IRQ4 (GPABC_INT) Interrupt Source Identify
  fields as IRQ0_SRC
0x14 IRQ5_SRC ro reset not defined — MCU IRQ5 (GPDEF_INT) Interrupt Source Identify
  fields as IRQ0_SRC
0x18 IRQ6_SRC ro reset not defined — MCU IRQ6 (PWM0_INT) Interrupt Source Identify
  fields as IRQ0_SRC
0x1C IRQ7_SRC ro reset not defined — Reserved
  fields as IRQ0_SRC
{0x0+4i} IRQ{i}_SRC ro reset not defined (i=8..11) — MCU IRQ{i} (TMR{i-8}_INT) Interrupt Source Identify
  fields as IRQ0_SRC
0x30 IRQ12_SRC ro reset not defined — MCU IRQ12 (UART0_INT) Interrupt Source Identify
  fields as IRQ0_SRC
0x34 IRQ13_SRC ro reset not defined — MCU IRQ13 (UART1_INT) Interrupt Source Identify
  fields as IRQ0_SRC
0x38 IRQ14_SRC ro reset not defined — MCU IRQ14 (SPI0_INT) Interrupt Source Identify
  fields as IRQ0_SRC
0x3C IRQ15_SRC ro reset not defined — MCU IRQ15 (SPI1_INT) Interrupt Source Identify
  fields as IRQ0_SRC
0x40 IRQ16_SRC ro reset not defined — Reserved
  fields as IRQ0_SRC
0x44 IRQ17_SRC ro reset not defined — MCU IRQ17 (IRC_INT) Interrupt Source Identify
  fields as IRQ0_SRC
0x48 IRQ18_SRC ro reset not defined — MCU IRQ18 (I2C0_INT) Interrupt Source Identify
  fields as IRQ0_SRC
0x4C IRQ19_SRC ro reset not defined — MCU IRQ19 (I2C1_INT) Interrupt Source Identify
  fields as IRQ0_SRC
0x50 IRQ20_SRC ro reset not defined — Reserved
  fields as IRQ0_SRC
0x54 IRQ21_SRC ro reset not defined — MCU IRQ21 (SC0_INT) Interrupt Source Identify
  fields as IRQ0_SRC
0x58 IRQ22_SRC ro reset not defined — MCU IRQ22 (SC1_INT) Interrupt Source Identify
  fields as IRQ0_SRC
0x5C IRQ23_SRC ro reset not defined — Reserved
  fields as IRQ0_SRC
0x60 IRQ24_SRC ro reset not defined — MCU IRQ24 (CKSD_INT) Interrupt Source Identify
  fields as IRQ0_SRC
0x64 IRQ25_SRC ro reset not defined — MCU IRQ25 (LCD_INT) Interrupt Source Identify
  fields as IRQ0_SRC
0x68 IRQ26_SRC ro reset not defined — MCU IRQ26 (DMA_INT) Interrupt Source Identify
  fields as IRQ0_SRC
0x6C IRQ27_SRC ro reset not defined — Reserved
  fields as IRQ0_SRC
0x70 IRQ28_SRC ro reset not defined — MCU IRQ28 (PDWU_INT) Interrupt Source Identify
  fields as IRQ0_SRC
0x74 IRQ29_SRC ro reset not defined — MCU IRQ29 (ADC_INT) Interrupt Source Identify
  fields as IRQ0_SRC
0x78 IRQ30_SRC ro reset not defined — MCU IRQ30 (ACMP_INT) Interrupt Source Identify
  fields as IRQ0_SRC
0x7C IRQ31_SRC ro reset not defined — MCU IRQ31 (RTC_INT) Interrupt Source Identify
  fields as IRQ0_SRC
0x80 NMI_SEL — NMI Source Interrupt Select Control Register
  [4:0] NMI_SEL — The NMI Interrupt to Cortex-m0 Can Be Selected from One of the Interrupt[31:0]. The NMI_SEL bit[4:0] is used to select the NMI interrupt source
0x84 MCU_IRQ — MCU Interrupt Request Source Register
  [31:0] MCU_IRQ — MCU IRQ Source Bits. The MCU_IRQ collects all the interrupts from the peripherals and generates the synchronous interrupt to MCU Cortex-M0. There are two modes to generate interrupt to Cortex-M0, the normal mode. The MCU_IRQ collects all interrupts from each peripheral and synchronizes them and then interrupts the Cortex-M0. When the MCU_IRQ[n] is "0", setting MCU_IRQ[n] "1" will generate an interrupt to Cortex_M0 NVIC[n]. When the MCU_IRQ[n] is "1" (means an interrupt is asserted), setting the MCU_bit[n] will clear the interrupt. Set MCU_IRQ[n] "0": no any effect
