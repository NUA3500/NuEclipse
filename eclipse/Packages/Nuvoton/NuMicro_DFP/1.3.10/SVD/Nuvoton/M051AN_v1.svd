# M051AN_v1 register map
File version: 1.0
M051AN_v1 SVD file
Registers are 32-bit, read-write, reset 0x0 unless marked. A register's access mark holds for its fields unless they carry their own. Offsets are from the block's base; lines under a group give offsets from that group; [hi:lo] are bit positions; {n}, {i} and the like mark numbered series; 'fields as' and 'values as' point back to an identical list; <NAME> marks a mode.

## Memory map
0x40004000 WDT size 0x4 — WDT Register Map
0x40010000 TMR01 blocks up to offset 0x30 — TIMER Register Map
0x40020000 I2C size 0x34 — I2C Register Map
0x40030000 SPI0 blocks up to offset 0x38 — SPI Register Map
0x40034000 SPI1 blocks up to offset 0x38 — SPI Register Map
0x40040000 PWMA blocks up to offset 0x80 — PWM Register Map
0x40050000 UART0 size 0x34 — UART Register Map
0x400E0000 ADC size 0x38 — ADC Register Map
0x40110000 TMR23 blocks up to offset 0x30 — TIMER Register Map
0x40140000 PWMB blocks up to offset 0x80 — PWM Register Map
0x40150000 UART1 size 0x34 — UART Register Map
0x50000000 GCR blocks up to offset 0x104 — GCR Register Map
0x50000200 CLK size 0x28 — CLK Register Map
0x50000300 INT size 0x88 — INT Register Map
0x50004000 GP blocks up to offset 0x2A0 — GPIO Register Map
0x5000C000 FMC size 0x1C — FMC Register Map
0x50010000 EBI_CTL size 0x8 — EBI Register Map
0xE000E000 SCS blocks up to offset 0xD24 — SCS Register Map

## INT — INT Register Map
Base 0x50000300
0x00 IRQ0_SRC ro reset not defined — IRQ0 (BOD) Interrupt Source Identity
  [2:0] INT_SRC — Bit0 : BOD_INT
0x04 IRQ1_SRC ro reset not defined — IRQ1 (WDT) Interrupt Source Identity
  [2:0] INT_SRC — Bit0 : WDT_INT
0x08 IRQ2_SRC ro reset not defined — IRQ2 (EINT0) Interrupt Source Identity
  [2:0] INT_SRC — Bit0: EINT0 - external interrupt 0 from P3.2
0x0C IRQ3_SRC ro reset not defined — IRQ3 (EINT1) Interrupt Source Identity
  [2:0] INT_SRC — Bit0: EINT1 - external interrupt 1 from P3.3
0x10 IRQ4_SRC ro reset not defined — IRQ4 (P0/1) Interrupt Source Identity
  [2:0] INT_SRC — Bit1: P1_INT. Bit0: P0_INT
0x14 IRQ5_SRC ro reset not defined — IRQ5 (P2/3/4) Interrupt Source Identity
  [2:0] INT_SRC — Bit2: P4_INT. Bit1: P3_INT. Bit0: P2_INT
0x18 IRQ6_SRC ro reset not defined — IRQ6 (PWMA) Interrupt Source Identity
  [3:0] INT_SRC — Bit3: PWM3_INT. Bit2: PWM2_INT. Bit1: PWM1_INT. Bit0: PWM0_INT
0x1C IRQ7_SRC ro reset not defined — IRQ7 (PWMB) Interrupt Source Identity
  [3:0] INT_SRC — Bit3: PWM7_INT. Bit2: PWM6_INT. Bit1: PWM5_INT. Bit0: PWM4_INT
{0x0+4i} IRQ{i}_SRC ro reset not defined (i=8..11) — IRQ{i} (TMR{i-8}) Interrupt Source Identity
  [2:0] INT_SRC — Bit0: TMR{i-8}_INT
0x30 IRQ12_SRC ro reset not defined — IRQ12 (UART0) Interrupt Source Identity
  [2:0] INT_SRC — Bit0: UART0_INT
0x34 IRQ13_SRC ro reset not defined — IRQ13 (UART1) Interrupt Source Identity
  [2:0] INT_SRC — Bit0: UART1_INT
0x38 IRQ14_SRC ro reset not defined — IRQ14 (SPI0) Interrupt Source Identity
  [2:0] INT_SRC — Bit0: SPI0_INT
0x3C IRQ15_SRC ro reset not defined — IRQ15 (SPI1) Interrupt Source Identity
  [2:0] INT_SRC — Bit0: SPI1_INT
0x40 IRQ16_SRC reset not defined — Reserved
0x44 IRQ17_SRC reset not defined — Reserved
0x48 IRQ18_SRC ro reset not defined — IRQ18 (I2C) Interrupt Source Identity
  [2:0] INT_SRC — Bit0: I2C_INT
{0x0+4i} IRQ{i}_SRC reset not defined (i=19..27) — Reserved
0x70 IRQ28_SRC ro reset not defined — IRQ28 (PWRWU) Interrupt Source Identity
  [2:0] INT_SRC — Bit0: PWRWU_INT
0x74 IRQ29_SRC ro reset not defined — IRQ29 (ADC) Interrupt Source Identity
  [2:0] INT_SRC — Bit0: ADC_INT
0x78 IRQ30_SRC reset not defined — Reserved
0x7C IRQ31_SRC reset not defined — Reserved
0x80 NMI_SEL — NMI Source Interrupt Select Control Register
  [4:0] NMI_SEL — The NMI interrupt to Cortex-M0 can be selected from one of the interrupt[31:0]. The NMI_SEL bit[4:0] used to select the NMI interrupt source
0x84 MCU_IRQ — MCU Interrupt Request Source Register
  [31:0] MCU_IRQ — MCU IRQ Source Register. The MCU_IRQ collects all the interrupts from the peripherals and generates the synchronous interrupt to Cortex-M0 core. There are two modes to generate interrupt to Cortex-M0, the normal mode and test mode. The MCU_IRQ collects all interrupts from each peripheral and synchronizes them then interrupts the Cortex-M0. When the MCU_IRQ[n] is "0": Set MCU_IRQ[n] "1" will generate an interrupt to Cortex_M0 NVIC[n]. When the MCU_IRQ[n] is "1" (mean an interrupt is assert), set 1 to the MCU_bit[n] will clear the interrupt and set MCU_IRQ[n] "0" : no any effect
