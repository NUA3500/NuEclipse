# NANO100AN_v1 register map
File version: 1.0
NANO100AN_v1 SVD file
Registers are 32-bit, read-write, reset 0x0 unless marked. A register's access mark holds for its fields unless they carry their own. Offsets are from the block's base; lines under a group give offsets from that group; [hi:lo] are bit positions; {n}, {i} and the like mark numbered series; 'fields as' and 'values as' point back to an identical list; <NAME> marks a mode.

## Memory map
0x40004000 WDT size 0xC — WDT Register Map
0x40008000 RTC blocks up to offset 0x90 — RTC Register Map
0x40010000 TMR0 blocks up to offset 0x218 — TMR Register Map
0x40010100 TMR1 size 0x1C — TMR Register Map
0x40020000 I2C0 blocks up to offset 0x30 — I2C Register Map
0x40030000 SPI0 blocks up to offset 0x40 — SPI Register Map
0x40040000 PWM0 blocks up to offset 0x88 — PWM Register Map
0x40050000 UART0 blocks up to offset 0x3C — UART Register Map
0x40060000 USB blocks up to offset 0xA8 — USB Register Map
0x400E0000 ADC blocks up to offset 0x68 — ADC Register Map
0x40110000 TMR2 size 0x1C — TMR Register Map
0x40110100 TMR3 size 0x1C — TMR Register Map
0x40120000 I2C1 blocks up to offset 0x30 — I2C Register Map
0x40130000 SPI1 blocks up to offset 0x40 — SPI Register Map
0x40140000 PWM1 blocks up to offset 0x88 — PWM Register Map
0x40150000 UART1 blocks up to offset 0x3C — UART Register Map
0x40190000 SC0 size 0x40 — SC Register Map
0x401A0000 I2S size 0x18 — I2S Register Map
0x401B0000 SC1 size 0x40 — SC Register Map
0x50000000 GCR blocks up to offset 0x104 — GCR Register Map
0x50000200 CLK blocks up to offset 0x34 — CLK Register Map
0x50000300 INT size 0x88 — SCS Register Map
0x50004000 GP blocks up to offset 0x358 — GP Register Map
0x50008000 VDMA blocks up to offset 0x88 — VDMA Register Map
0x50008100 PDMA_CH1 blocks up to offset 0x84 — VDMA Register Map
0x50008200 PDMA_CH2 blocks up to offset 0x84 — VDMA Register Map
0x50008300 PDMA_CH3 blocks up to offset 0x84 — VDMA Register Map
0x50008400 PDMA_CH4 blocks up to offset 0x84 — VDMA Register Map
0x50008F00 DMA_GCR size 0x10 — VDMA Register Map
0x5000C000 FMC blocks up to offset 0x44 — FMC Register Map
0x50010000 EBI size 0x8 — EBI Register Map
0xE000E000 SCS blocks up to offset 0xD24 — SCS Register Map

## INT — SCS Register Map
Base 0x50000300
0x00 IRQ0_SRC ro reset not defined — MCU IRQ0 (BOD_INT) Interrupt Source Identify
  [3:0] INT_SRC — Interrupt Source. Define the interrupt sources for interrupt event.
0x04 IRQ1_SRC ro reset not defined — MCU IRQ1 (WDT_INT) Interrupt Source Identify
  fields as IRQ0_SRC
0x08 IRQ2_SRC ro reset not defined — MCU IRQ2 (EINT0) Interrupt Source Identify
  fields as IRQ0_SRC
0x0C IRQ3_SRC ro reset not defined — MCU IRQ3 (EINT1) Interrupt Source Identify
  fields as IRQ0_SRC
0x10 IRQ4_SRC ro reset not defined — MCU IRQ4 (GPABC_INT) Interrupt Source Identify
  fields as IRQ0_SRC
0x14 IRQ5_SRC ro reset not defined — MCU IRQ5 (GPDEF_INT) Interrupt Source Identify
  fields as IRQ0_SRC
0x18 IRQ6_SRC ro reset not defined — MCU IRQ6 (PWM0_INT) Interrupt Source Identify
  fields as IRQ0_SRC
0x1C IRQ7_SRC ro reset not defined — MCU IRQ7 (PWM1_INT) Interrupt Source Identify
  fields as IRQ0_SRC
{0x0+4i} IRQ{i}_SRC ro reset not defined (i=8..11) — MCU IRQ{i} (TMR{i-8}_INT) Interrupt Source Identify
  fields as IRQ0_SRC
0x30 IRQ12_SRC ro reset not defined — MCU IRQ12 (UART0_INT) Interrupt Source Identify
  fields as IRQ0_SRC
0x34 IRQ13_SRC ro reset not defined — MCU IRQ13 (UART1_INT) Interrupt Source Identify
  fields as IRQ0_SRC
{0x0+4i} IRQ{i}_SRC ro reset not defined (i=14..16) — MCU IRQ{i} (SPI{i-14}_INT) Interrupt Source Identify
  fields as IRQ0_SRC
0x44 IRQ17_SRC ro reset not defined — MCU IRQ17 (IRC_INT) Interrupt Source Identify
  fields as IRQ0_SRC
0x48 IRQ18_SRC ro reset not defined — MCU IRQ18 (I2C0_INT) Interrupt Source Identify
  fields as IRQ0_SRC
0x4C IRQ19_SRC ro reset not defined — MCU IRQ19 (I2C1_INT) Interrupt Source Identify
  fields as IRQ0_SRC
0x50 IRQ20_SRC ro reset not defined — MCU IRQ20 (Reserved) Interrupt Source Identify
  fields as IRQ0_SRC
0x54 IRQ21_SRC ro reset not defined — MCU IRQ21 (SC0_INT) Interrupt Source Identify
  fields as IRQ0_SRC
0x58 IRQ22_SRC ro reset not defined — MCU IRQ22 (SC1_INT) Interrupt Source Identify
  fields as IRQ0_SRC
0x5C IRQ23_SRC ro reset not defined — MCU IRQ23 (USB_INT) Interrupt Source Identify
  fields as IRQ0_SRC
0x60 IRQ24_SRC ro reset not defined — Reserved
  fields as IRQ0_SRC
0x64 IRQ25_SRC ro reset not defined — Reserved
  fields as IRQ0_SRC
0x68 IRQ26_SRC ro reset not defined — MCU IRQ26 (DMA_INT) Interrupt Source Identify
  fields as IRQ0_SRC
0x6C IRQ27_SRC ro reset not defined — MCU IRQ27 (I2S_INT) Interrupt Source Identify
  fields as IRQ0_SRC
0x70 IRQ28_SRC ro reset not defined — MCU IRQ28 (PDWU_INT) Interrupt Source Identify
  fields as IRQ0_SRC
0x74 IRQ29_SRC ro reset not defined — MCU IRQ29 (ADC_INT) Interrupt Source Identify
  fields as IRQ0_SRC
0x78 IRQ30_SRC ro reset not defined — Reserved
  fields as IRQ0_SRC
0x7C IRQ31_SRC ro reset not defined — MCU IRQ31 (RTC_INT) Interrupt Source Identify
  fields as IRQ0_SRC
0x80 NMI_SEL — NMI Source Interrupt Select Control Register
  [4:0] NMI_SEL — The NMI Interrupt To Cortex-M0 Can Be Selected From One Of The Interrupt[31:0]. The NMI_SEL bit[4:0] used to select the NMI interrupt source
0x84 MCU_IRQ — MCU Interrupt Request Source Register
  [31:0] MCU_IRQ — MCU IRQ Source Register. The MCU_IRQ collects all the interrupts from the peripherals and generates the synchronous interrupt to MCU Cortex-M0. There are two modes to generate interrupt to Cortex-M0, the normal mode. When the MCU_IRQ[n] is "0", set MCU_IRQ[n] "1" will generate an interrupt to Cortex_M0 NVIC[n]. When the MCU_IRQ[n] is "1" (mean an interrupt is assert), set the MCU_bit[n] will clear the interrupt. Set MCU_IRQ[n] "0" : no any effect
