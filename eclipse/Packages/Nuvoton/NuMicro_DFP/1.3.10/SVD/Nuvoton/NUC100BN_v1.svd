# NUC100BN_v1 register map
File version: 1.0
NUC100BN_v1 SVD file
Registers are 32-bit, read-write, reset 0x0 unless marked. A register's access mark holds for its fields unless they carry their own. Offsets are from the block's base; lines under a group give offsets from that group; [hi:lo] are bit positions; {n}, {i} and the like mark numbered series; 'fields as' and 'values as' point back to an identical list; <NAME> marks a mode.

## Memory map
0x40004000 WDT size 0x4 — WDT Register Map
0x40008000 RTC size 0x34 — RTC Register Map
0x40010000 TMR01 blocks up to offset 0x30 — TMR Register Map
0x40020000 I2C0 size 0x34 — I2C Register Map
0x40030000 SPI0 blocks up to offset 0x3C — SPI Register Map
0x40034000 SPI1 blocks up to offset 0x3C — SPI Register Map
0x400386A0 I2C1 size 0x34 — I2C Register Map
0x40040000 PWMA blocks up to offset 0x80 — PWM Register Map
0x40050000 UART0 size 0x34 — UART Register Map
0x40060000 USB blocks up to offset 0x94 — USB Register Map
0x400D0000 CMP size 0xC — CMP Register Map
0x400E0000 ADC blocks up to offset 0x44 — ADC Register Map
0x40100000 PS2 size 0x20 — PS2 Register Map
0x40110000 TMR23 blocks up to offset 0x30 — TMR Register Map
0x40130000 SPI2 blocks up to offset 0x3C — SPI Register Map
0x40134000 SPI3 blocks up to offset 0x3C — SPI Register Map
0x40140000 PWMB blocks up to offset 0x80 — PWM Register Map
0x40150000 UART1 size 0x34 — UART Register Map
0x40154000 UART2 size 0x34 — UART Register Map
0x401A0000 I2S size 0x18 — I2S Register Map
0x50000000 GCR blocks up to offset 0x104 — GCR Register Map
0x50000200 CLK size 0x28 — CLK Register Map
0x50000300 INT size 0x88 — INT Register Map
0x50004000 GP blocks up to offset 0x318 — GPIO Register Map
{0x50008000+0x100*n} PDMA_ch{n} blocks up to offset 0x84 (n=0..8) — PDMA Register Map
0x50008F00 PDMA_GCR size 0x14 — PDMA Register Map
0x5000C000 FMC size 0x1C — FMC Register Map
0x50010000 EBI size 0x8 — EBI Register Map
0xE000E000 SCS blocks up to offset 0xD24 — SCS Register Map

## INT — INT Register Map
Base 0x50000300
0x00 IRQ0_SRC ro reset not defined — IRQ0 (BOD) Interrupt Source Identity
  [3:0] INT_SRC — Interrupt Source. Define the interrupt sources for interrupt event.
0x04 IRQ1_SRC ro reset not defined — IRQ1 (WDT) Interrupt Source Identity
  fields as IRQ0_SRC
0x08 IRQ2_SRC ro reset not defined — IRQ2 (EINT0) Interrupt Source Identity
  fields as IRQ0_SRC
0x0C IRQ3_SRC ro reset not defined — IRQ3 (EINT1) Interrupt Source Identity
  fields as IRQ0_SRC
0x10 IRQ4_SRC ro reset not defined — IRQ4 (GPA/B) Interrupt Source Identity
  fields as IRQ0_SRC
0x14 IRQ5_SRC ro reset not defined — IRQ5 (GPC/D/E) Interrupt Source Identity
  fields as IRQ0_SRC
0x18 IRQ6_SRC ro reset not defined — IRQ6 (PWMA) Interrupt Source Identity
  fields as IRQ0_SRC
0x1C IRQ7_SRC ro reset not defined — IRQ7 (PWMB) Interrupt Source Identity
  fields as IRQ0_SRC
{0x0+4i} IRQ{i}_SRC ro reset not defined (i=8..11) — IRQ{i} (TMR{i-8}) Interrupt Source Identity
  fields as IRQ0_SRC
0x30 IRQ12_SRC ro reset not defined — IRQ12 (UART0) Interrupt Source Identity
  fields as IRQ0_SRC
0x34 IRQ13_SRC ro reset not defined — IRQ13 (UART1) Interrupt Source Identity
  fields as IRQ0_SRC
{0x0+4i} IRQ{i}_SRC ro reset not defined (i=14..16) — IRQ{i} (SPI{i-14}) Interrupt Source Identity
  fields as IRQ0_SRC
0x44 IRQ17_SRC ro reset not defined — IRQ17 (SPI3)) Interrupt Source Identity
  fields as IRQ0_SRC
0x48 IRQ18_SRC ro reset not defined — IRQ18 (I2C0) Interrupt Source Identity
  fields as IRQ0_SRC
0x4C IRQ19_SRC ro reset not defined — IRQ19 (I2C1) Interrupt Source Identity
  fields as IRQ0_SRC
{0x0+4i} IRQ{i}_SRC ro reset not defined (i=20..22) — IRQ{i} (Reserved) Interrupt Source Identity
  fields as IRQ0_SRC
0x5C IRQ23_SRC ro reset not defined — IRQ23 (USBD) Interrupt Source Identity
  fields as IRQ0_SRC
0x60 IRQ24_SRC ro reset not defined — IRQ24 (PS/2) Interrupt Source Identity
  fields as IRQ0_SRC
0x64 IRQ25_SRC ro reset not defined — IRQ25 (ACMP) Interrupt Source Identity
  fields as IRQ0_SRC
0x68 IRQ26_SRC ro reset not defined — IRQ26 (PDMA) Interrupt Source Identity
  fields as IRQ0_SRC
0x6C IRQ27_SRC ro reset not defined — IRQ27 (I2S) Interrupt Source Identity
  fields as IRQ0_SRC
0x70 IRQ28_SRC ro reset not defined — IRQ28 (PWRWU) Interrupt Source Identity
  fields as IRQ0_SRC
0x74 IRQ29_SRC ro reset not defined — IRQ29 (ADC) Interrupt Source Identity
  fields as IRQ0_SRC
0x78 IRQ30_SRC ro reset not defined — IRQ30 (Reserved) Interrupt Source Identity
  fields as IRQ0_SRC
0x7C IRQ31_SRC ro reset not defined — IRQ31 (RTC) Interrupt Source Identity
  fields as IRQ0_SRC
0x80 NMI_SEL — NMI Source Interrupt Select Control Register
  [4:0] NMI_SEL — NMI Interrupt Source Selection. The NMI interrupt to Cortex-M0 can be selected from one of the peripheral interrupt by setting NMI_SEL.
0x84 MCU_IRQ — MCU IRQ Number Identity Register
  [31:0] MCU_IRQ — MCU IRQ Source Register. The MCU_IRQ collects all the interrupts from the peripherals and generates the synchronous interrupt to Cortex-M0. There are two modes to generate interrupt to Cortex-M0, the normal mode and test mode. The MCU_IRQ collects all interrupts from each peripheral and synchronizes them and interrupts the Cortex-M0. When the MCU_IRQ[n] is 0: Set MCU_IRQ[n] 1 will generate an interrupt to Cortex_M0 NVIC[n]. When the MCU_IRQ[n] is 1 (mean an interrupt is assert), setting MCU_IRQ[n] 1 will clear the interrupt and setting MCU_IRQ[n] 0 has no effect.
